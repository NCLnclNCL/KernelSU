## kernel/Kconfig
```kconfig
menu "KernelSU"

config KSU
	bool "KernelSU function support"
	default y
	help
	  Enable kernel-level root privileges on Android System.
	  To compile as a module, choose M here: the
	  module will be called kernelsu.
config KSU_LSM_SECURITY_HOOKS
	bool "KernelSU LSM Hook"
	depends on KSU
	default n
	help
	  Enable Linux Security Module (LSM) hooks support for
	  KernelSU.
config KSU_LSM_HOOKS
	bool "KernelSU LSM Hook"
	depends on KSU
	default n
	help
	  Enable Linux Security Module (LSM) hooks support for
	  KernelSU.

config KSU_MANUAL_HOOK
	bool "KernelSU manual hook (stub) (dummy)"
	depends on KSU
	default y
	help
	  Always Enabled now, do not disable.

config KSU_FEATURE_ADBROOT
	bool "KernelSU ADB Root feature"
	depends on KSU
	default n
	help
	  Build KernelSU's adb root feature.

config KSU_DEBUG
	bool "KernelSU debug mode"
	depends on KSU
	default n
	help
	  Enable KernelSU debug mode.
config KSU_SUSFS
	bool "SUSFS"
	default n
config KSU_SUSFS_SUS_MOUNT
	bool "SUS_MOUNT"
	depends on KSU_SUSFS
config KSU_SUSFS_ENABLE_LOG
	bool "SUS_LOG"
	depends on KSU_SUSFS
endmenu
```
